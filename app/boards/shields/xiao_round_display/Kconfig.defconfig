## app/boards/shields/xiao_round_display/Kconfig.defconfig
```kconfig
if SHIELD_XIAO_ROUND_DISPLAY
if LVGL

choice LV_COLOR_DEPTH
	default LV_COLOR_DEPTH_16
endchoice

config LV_COLOR_16_SWAP
    default y

endif # LVGL
endif # SHIELD_XIAO_ROUND_DISPLAY
```

## app/boards/shields/xiao_round_display/Kconfig.shield
```kconfig
config SHIELD_XIAO_ROUND_DISPLAY
	def_bool $(shields_list_contains,xiao_round_display)
```

## drivers/Kconfig
```kconfig
# Copyright (c) 2021 Nordic Semiconductor ASA
# SPDX-License-Identifier: Apache-2.0
rsource "input/Kconfig"
rsource "display/Kconfig"

menu "Drivers"
rsource "sensor/Kconfig"
endmenu
```

## drivers/display/gc9a01/Kconfig
```kconfig
menuconfig GC9A01
    bool "GC9A01 compatible display controller driver"
    default n
    depends on DT_HAS_SEEEDROUNDDISPLAY_GC9A01_ENABLED
    select SPI
    help
        Enable driver for GC9A01 compatible controller.
```

## drivers/input/chsc6x/Kconfig
```kconfig
menuconfig INPUT_CHSC6X
	bool "Use out of tree CHSC6X capacitive touch panel driver"
	default y
	depends on DT_HAS_SEEEDROUNDDISPLAY_CHSC6X_ENABLED
	select GPIO
	select I2C
	help
	  Enable out of tree driver for CHSC6X touch panel.
```

## dts/bindings/input/seeedrounddisplay,chsc6x.yaml
```yaml
description: CHSC6X touchscreen sensor

compatible: "seeedrounddisplay,chsc6x"

include: i2c-device.yaml

properties:
  irq-gpios:
    type: phandle-array
    description: |
      The irq signal defaults to active low as produced by the
      sensor. The property value should ensure the flags properly
      describe the signal that is presented to the driver.

  height:
    type: int
    required: true
    description: |
      Height of the panel driven by the controller, with the units in pixels.

  width:
    type: int
    required: true
    description: |
      Width of the panel driven by the controller, with the units in pixels.

  rotation:
    type: int
    default: 0
    enum:
      - 0
      - 90
      - 180
      - 270
    description:
      Display rotation in degrees.
```
